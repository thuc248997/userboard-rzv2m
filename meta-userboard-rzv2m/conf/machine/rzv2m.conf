## meta-userboard-rzv2m/conf/machine/rzv2m.conf
```bitbake
#@TYPE: Machine
#@NAME: RZV2M machine
#@DESCRIPTION: Machine configuration for running RZV2M

SOC_FAMILY = "r9a09g011gbg"

DEFAULTTUNE ?= "cortexa53"
require conf/machine/include/tune-cortexa53.inc
require conf/machine/include/${SOC_FAMILY}.inc

# 32BIT package install (default is disable)
# This variables can be used only in multilib.
USE_32BIT_PKGS ?= "0"
USE_32BIT_WAYLAND ?= "0"
USE_32BIT_MMP ?= "0"

MACHINE_FEATURES = ""

KERNEL_IMAGETYPE = "Image"
#IMAGE_FSTYPES_append = " tar.bz2 ext4"

SERIAL_CONSOLE = "115200 ttySC0"

# Configuration for kernel
PREFERRED_PROVIDER_virtual/kernel = "linux-renesas"
# Device tree for RZV2M
KERNEL_DEVICETREE = " \
    renesas/r9a09g011gbg-evaluation-board.dtb \
"


# bootloader
EXTRA_IMAGEDEPENDS += " bootloader"

# u-boot
PREFERRED_VERSION_u-boot = "v2019.12%"
EXTRA_IMAGEDEPENDS += " u-boot"
# V2M u-boot configure
UBOOT_CONFIG ??= "rzv2m"
UBOOT_CONFIG[rzv2m] = "r9a09g011gbg_rzv2m_defconfig"

# libdrm
PREFERRED_VERSION_libdrm = "2.4.85"

# Add variable to Build Configuration in build log
BUILDCFG_VARS_append = " SOC_FAMILY"

# Command using to build kernel-module-gles
HOSTTOOLS += "sync"
```
